## meta-imx-expand-caam/conf/layer.conf
```bitbake
# We have a conf and classes directory, add to BBPATH
BBPATH .= ":${LAYERDIR}"

# We have recipes-* directories, add to BBFILES
BBFILES += "${LAYERDIR}/recipes-*/*/*.bb \
            ${LAYERDIR}/recipes-*/*/*.bbappend"

BBFILE_COLLECTIONS += "meta-imx-expand-caam"
BBFILE_PATTERN_meta-imx-expand-caam = "^${LAYERDIR}/"
BBFILE_PRIORITY_meta-imx-expand-caam = "10"
LAYERSERIES_COMPAT_meta-imx-expand-caam = "warrior zeus"
```
